/*
 * Minimal 1x2 shield using GPIO-direct kscan for ZMK testing.
 * Pins default to P0.03 and P0.04 with pull-ups, active-low.
 */

/ {
    chosen {
        zmk,kscan = &kscan0;
    };

    kscan0: kscan {
        compatible = "zmk,kscan-gpio-direct";
        label = "KSCAN";
        input-gpios = <&gpio0 3 (GPIO_ACTIVE_LOW | GPIO_PULL_UP)>,
                      <&gpio0 4 (GPIO_ACTIVE_LOW | GPIO_PULL_UP)>;
        debounce-press-ms = <5>;
        debounce-release-ms = <5>;
    };
};

