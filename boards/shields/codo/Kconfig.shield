## boards/shields/codo/Kconfig.shield
```kconfig
# Copyright (c) 2020 Pete Johanson
# SPDX-License-Identifier: MIT

config SHIELD_CODO_LEFT
    def_bool $(shields_list_contains,codo_left)

config SHIELD_CODO_RIGHT
    def_bool $(shields_list_contains,codo_right)
```
