/* Minimal keymap for the 1x2 test shield */

#include <behaviors.dtsi>
#include <dt-bindings/zmk/keys.h>

/ {
    keymap {
        compatible = "zmk,keymap";

        default_layer {
            bindings = <
                &kp A    &kp B
            >;
        };
    };
};

